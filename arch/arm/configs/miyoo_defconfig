## arch/arm/configs/miyoo_defconfig
```kconfig
# CONFIG_LOCALVERSION_AUTO is not set
CONFIG_DEFAULT_HOSTNAME="miyoo"
CONFIG_NO_HZ=y
CONFIG_HIGH_RES_TIMERS=y
CONFIG_CGROUPS=y
CONFIG_BLK_DEV_INITRD=y
# CONFIG_RD_GZIP is not set
# CONFIG_RD_BZIP2 is not set
# CONFIG_RD_LZMA is not set
# CONFIG_RD_LZO is not set
# CONFIG_RD_LZ4 is not set
# CONFIG_ARCH_MULTI_V7 is not set
CONFIG_ARCH_SUNXI=y
CONFIG_AEABI=y
CONFIG_OABI_COMPAT=y
CONFIG_CPU_FREQ=y
CONFIG_CPUFREQ_DT=y
# CONFIG_SECCOMP is not set
# CONFIG_GCC_PLUGINS is not set
CONFIG_MODULES=y
CONFIG_MODULE_UNLOAD=y
CONFIG_UEVENT_HELPER=y
CONFIG_DEVTMPFS=y
CONFIG_DEVTMPFS_MOUNT=y
CONFIG_MTD=y
CONFIG_BLK_DEV_LOOP=y
CONFIG_SCSI=y
CONFIG_BLK_DEV_SD=y
CONFIG_CHR_DEV_SG=y
CONFIG_CHR_DEV_SCH=y
CONFIG_KEYBOARD_GPIO_POLLED=y
# CONFIG_INPUT_MOUSE is not set
CONFIG_SERIAL_8250=y
CONFIG_SERIAL_8250_CONSOLE=y
CONFIG_SERIAL_8250_NR_UARTS=8
CONFIG_SERIAL_8250_RUNTIME_UARTS=8
CONFIG_SERIAL_8250_DW=y
CONFIG_SERIAL_OF_PLATFORM=y
# CONFIG_HW_RANDOM is not set
CONFIG_POWER_SUPPLY=y
CONFIG_BATTERY_MIYOO=y
# CONFIG_HWMON is not set
CONFIG_MFD_SYSCON=y
CONFIG_REGULATOR=y
CONFIG_REGULATOR_FIXED_VOLTAGE=y
CONFIG_FB=y
CONFIG_FB_MIYOO_ST7789S=y
CONFIG_BACKLIGHT_CLASS_DEVICE=y
CONFIG_BACKLIGHT_PWM=y
CONFIG_FRAMEBUFFER_CONSOLE=y
CONFIG_FRAMEBUFFER_CONSOLE_DETECT_PRIMARY=y
CONFIG_LOGO=y
CONFIG_SOUND=y
CONFIG_SND=y
CONFIG_SND_OSSEMUL=y
CONFIG_SND_PCM_OSS=y
# CONFIG_SND_VERBOSE_PROCFS is not set
# CONFIG_SND_DRIVERS is not set
CONFIG_SND_SOC=y
CONFIG_SND_SUN4I_CODEC=y
CONFIG_USB=y
CONFIG_USB_ANNOUNCE_NEW_DEVICES=y
CONFIG_USB_EHCI_HCD=y
CONFIG_USB_EHCI_HCD_PLATFORM=y
CONFIG_USB_OHCI_HCD=y
CONFIG_USB_OHCI_HCD_PLATFORM=y
CONFIG_USB_MUSB_HDRC=y
CONFIG_USB_MUSB_SUNXI=y
CONFIG_NOP_USB_XCEIV=y
CONFIG_USB_GADGET=y
CONFIG_USB_G_SERIAL=y
CONFIG_MMC=y
CONFIG_MMC_SUNXI=y
CONFIG_DMADEVICES=y
CONFIG_STAGING=y
# CONFIG_IOMMU_SUPPORT is not set
CONFIG_PWM=y
CONFIG_PWM_SUN4I=y
CONFIG_PHY_SUN4I_USB=y
CONFIG_EXT2_FS=y
CONFIG_EXT3_FS=y
CONFIG_VFAT_FS=y
CONFIG_PROC_CHILDREN=y
CONFIG_TMPFS=y
CONFIG_TMPFS_POSIX_ACL=y
CONFIG_NLS_CODEPAGE_437=y
CONFIG_NLS_ISO8859_1=y
CONFIG_KEYS=y
CONFIG_CRYPTO_ECHAINIV=m
CONFIG_CRYPTO_DRBG_MENU=y
CONFIG_PRINTK_TIME=y
CONFIG_DEBUG_FS=y
CONFIG_KGDB=y
CONFIG_KGDB_KDB=y
CONFIG_DEBUG_KERNEL=y
# CONFIG_FTRACE is not set
CONFIG_DEBUG_LL=y
CONFIG_DEBUG_UART_PHYS=0x01c25400
CONFIG_DEBUG_UART_VIRT=0xf1c25400
```

## drivers/input/fingerprint/fpc/Kconfig
```kconfig
#
# Fpc Fingerprint driver configuration
#

config QCOM_FINGERPRINT_FPC
	tristate "fpc fingerprint driver"
	default n
```

## drivers/input/fingerprint/goodix/Kconfig
```kconfig
#
# Goodix Fingerprint driver configuration
#

config QCOM_FINGERPRINT_GOODIX
	tristate "generic goodix fingerprint driver"
	default n
	help
	add support for goodix fingerprint driver.
```

## drivers/input/fingerprint/silead/Kconfig
```kconfig
#
# Silead Fingerprint driver configuration
#

config QCOM_FINGERPRINT_SILEAD
	tristate "Silead Fingerprint driver support"
	default n
	help
	This supports Silead Fingerprint drivers.
```

## drivers/media/platform/msm/camera_v2/sensor/zte_eeprom/Kconfig
```kconfig
config S5K3L6_047_EEPROM
	bool "ZTE S5K3L6_047 Calibration support"
	depends on MSMB_CAMERA
	default n
	help
	  Enable support for ROM Interface for Calibration
	  Provides interface for reading the Claibration data.
	  and also provides support for writing data in case of FLASH ROM.
	  Currently supports CCI  protocol
```

## drivers/vendor/common/touchscreen/tlsc6x/Kconfig
```kconfig
#
# tlsc6x touchscreen driver configuration
#

config TOUCHSCREEN_TLSC6X
	bool "Focaltech Touchscreen"
		depends on I2C
		default n
		help
		  Say Y here if you have tlsc6x touch panel.
		  If unsure, say N.

if TOUCHSCREEN_TLSC6X
config TS_TLSC6X_MTK_INTERFACE
	tristate "tlsc6x driver test over Dragon Board"
	depends on TOUCHSCREEN_TLSC6X
	help
	  This enables support for tlsc6x driver in MTK platform.

endif
```

## drivers/vendor/soc/qcom/Kconfig
```kconfig
source "drivers/vendor/soc/qcom/vlog/Kconfig"
source "drivers/vendor/soc/qcom/logcat/Kconfig"
source "drivers/vendor/soc/qcom/sdlog/Kconfig"
source "drivers/vendor/soc/qcom/pmlog/Kconfig"
source "drivers/vendor/soc/qcom/klog/Kconfig"
source "drivers/vendor/soc/qcom/imem_info/Kconfig"
source "drivers/vendor/soc/qcom/vcfg/Kconfig"
source "drivers/vendor/soc/qcom/dpn/Kconfig"
source "drivers/vendor/soc/qcom/subsys_restart/Kconfig"
```

## drivers/vendor/soc/qcom/sdlog/Kconfig
```kconfig
#
# Sdlog Driver
#

config VENDOR_SDLOG
	bool "Sdlog Driver"
	default y
	help
	  This program is used for capture the modem log.
```

## sound/soc/codecs/aw87359_stereo/Kconfig
```kconfig
config ZTE_AW87359_SMART_PA_STEREO
	tristate "SoC Audio for awinic AW87359 Smart K PA in stereo"
	depends on I2C
	help
	  This option enables support for AW87359 Smart K PA in stereo.
```

## sound/soc/codecs/tfa9890/Kconfig
```kconfig
config ZTE_NXP9890_SMART_PA_USE_QUIN
	bool "ZTE ADDED NXP TFA9890 SmartPA uses quinary mi2s"
```
