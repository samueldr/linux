/* Copyright (c) 2013, The Linux Foundation. All rights reserved.
 *
 * This program is free software; you can redistribute it and/or modify
 * it under the terms of the GNU General Public License version 2 and
 * only version 2 as published by the Free Software Foundation.
 *
 * This program is distributed in the hope that it will be useful,
 * but WITHOUT ANY WARRANTY; without even the implied warranty of
 * MERCHANTABILITY or FITNESS FOR A PARTICULAR PURPOSE.  See the
 * GNU General Public License for more details.
 */

/*---------------------------------------------------------------------------
 * This file is autogenerated file using gcdb parser. Please do not edit it.
 * Update input XML file to add a new entry or update variable in this file
 * VERSION = "1.0"
 *---------------------------------------------------------------------------*/
&mdss_mdp {
	dsi_lcetron_hx83104a_inn_720p_video: qcom,mdss_dsi_lcetron_hx83104a_inn_720p_video {
		qcom,mdss-dsi-panel-name = "lcetron hx83104a inn 720p video mode dsi panel";
		zte,lcd-init-code-version = "20200329";
		qcom,cont-splash-enabled;
		qcom,panel-supply-entries = <&dsi_panel_pwr_supply>;
		zte,lcd_bl_vsp_vsn_voltage = <0xf>;
		zte,set-reset-pin-ctrl;
		zte,lcm_reset_pin_keep_high_sleeping;
		qcom,mdss-dsi-panel-type = "dsi_video_mode";
		qcom,mdss-dsi-panel-framerate = <60>;
		qcom,mdss-dsi-virtual-channel-id = <0>;
		qcom,mdss-dsi-stream = <0>;
		qcom,mdss-dsi-panel-width = <240>;
		qcom,mdss-dsi-panel-height = <320>;
		qcom,mdss-dsi-h-front-porch = <48>;
		qcom,mdss-dsi-h-back-porch = <48>;
		qcom,mdss-dsi-h-pulse-width = <16>;
		qcom,mdss-dsi-h-sync-skew = <0>;
		qcom,mdss-dsi-v-back-porch = <40>;
		qcom,mdss-dsi-v-front-porch = <36>;
		qcom,mdss-dsi-v-pulse-width = <4>;
		qcom,mdss-dsi-h-left-border = <0>;
		qcom,mdss-dsi-h-right-border = <0>;
		qcom,mdss-dsi-v-top-border = <0>;
		qcom,mdss-dsi-v-bottom-border = <0>;
		qcom,mdss-dsi-bpp = <16>;
		qcom,mdss-dsi-color-order = "rgb_swap_rgb";
		qcom,mdss-dsi-underflow-color = <0xff>;
		qcom,mdss-dsi-border-color = <0>;
		qcom,mdss-dsi-on-command = [
		39 01 00 00 00 00 04 b9 83 11 2a
		39 01 00 00 00 00 05 CF 00 14 00 C0
		39 01 00 00 00 00 02 CC 08
		39 01 00 00 00 00 05 C9 04 0A 8C 01
		39 01 00 00 00 00 09 B1 08 2F 2F 80 80 4A 4F AA
		39 01 00 00 00 00 10 B2 00 02 00 52 A0 00 08 30 31 11 15 00 10 A3 87
		39 01 00 00 00 00 03 D2 32 32
		39 01 00 00 00 00 1C B4 0B E1 0B E1 0B E1 0B E1 0B E1 0B E1 00 FF 00
		FF 00 00 0C 0F 00 3A 08 0D 0F 00 3A
		39 01 00 00 00 00 09 C7 00 00 04 E0 33 00 20 40
		39 01 00 00 00 00 04 B6 7B 7B E3
		39 01 00 00 10 00 2B D3 C0 00 00 00 00 01 00 0A 0A 09 09 00 0F 0B 0B
		0B 0B 32 10 09 00 09 32 10 0F 00 0F 32 10 00 00 00 00 00 00 00 00 00 00 0A 05 AB
		39 01 00 00 00 00 02 BD 01
		39 01 00 00 00 00 04 CB 25 11 01
		39 01 00 00 00 00 02 BD 00
		39 01 00 00 05 00 31 D5 18 18 18 18 18 18 18 18 18 18 18 18 18 18 30
		19 18 20 18 18 18 30 20 31 19 2F 01 18 2F 18 31 18 03 18 05 00 07 02 09 04 18 06 18 08 18 18 18 18
		39 01 00 00 00 00 31 D6 18 18 18 18 18 18 18 18 18 18 18 18 18 18 30
		19 18 20 18 18 18 30 20 31 19 2F 08 18 2F 18 31 18 06 18 04 09 02 07 00 05 18 03 18 01 18 18 18 18
		39 01 00 00 00 00 19 D8 AA AA AA FA FF AA AA AB AA AA BF FA AA AA AA EA AA AA AA AB AA AA AA AA
		39 01 00 00 00 00 02 BD 01
		39 01 00 00 00 00 19 D8 AA AA BA BF FF AA AA AA AF FA BF FA AA AA BA BF FF AA AA AA AF FA BF FA
		39 01 00 00 00 00 02 BD 02
		39 01 00 00 00 00 0D D8 AA AA BA BF FF AA AA AA AF FA BF FA
		39 01 00 00 00 00 02 BD 03
		39 01 00 00 00 00 19 D8 AA AA AA EA AA AA AA AB AA AA AA AA AA AA BA BF FF AA AA AA AF FA BF FA
		39 01 00 00 00 00 02 BD 00
		39 01 00 00 00 00 18 E7 0F 0F 1E 82 1E 82 00 50 02 02 00 00 02 02 02 05 14 14 32 B9 23 B9 08
		39 01 00 00 00 00 02 BD 01
		39 01 00 00 00 00 09 E7 02 00 5A 01 64 0E 3C 0F
		39 01 00 00 00 00 02 BD 02
		39 01 00 00 00 00 1E E7 00 00 08 00 01 00 00 00 00 00 00 00 00 00 00
		00 00 00 00 00 00 00 04 00 00 00 00 02 00
		39 01 00 00 00 00 02 BD 00
		39 01 00 00 00 00 02 E9 C3
		39 01 00 00 00 00 03 CB D2 63
		39 01 00 00 00 00 02 E9 3F
		39 01 00 00 00 00 02 C1 01
		39 01 00 00 00 00 02 BD 01
		39 01 00 00 00 00 02 E9 C8
		39 01 00 00 00 00 02 D3 81
		39 01 00 00 00 00 02 E9 3F
		39 01 00 00 00 00 02 BD 00
		39 01 00 00 00 00 03 C1 01 00
		39 01 00 00 00 00 02 BD 01
		39 01 00 00 00 00 3A C1 FF FA F5 EF EB E6 E1 D7 D2 CD C7 C2 BE B8 B3
		AE A9 A3 9E 95 8C 83 7B 73 6B 63 5B 54 4D 47 40 3A 33 2D 26 20 1A 14
		0E 09 06 04 02 01 00 03 56 AF 24 3D 14 0E 1D 5A B8 3A 40
		39 01 00 00 00 00 02 BD 02
		39 01 00 00 00 00 3A C1 FF FA F5 EF EB E6 E1 D7 D2 CD C7 C2 BE B8 B3
		AE A9 A3 9E 95 8C 83 7B 73 6B 63 5B 54 4D 47 40 3A 33 2D 26 20 1A 14
		0E 09 06 04 02 01 00 03 56 AF 24 3D 14 0E 1D 5A B8 3A 40
		39 01 00 00 00 00 02 BD 03
		39 01 00 00 00 00 3A C1 FF FA F5 EF EB E6 E1 D7 D2 CD C7 C2 BE B8 B3
		AE A9 A3 9E 95 8C 83 7B 73 6B 63 5B 54 4D 47 40 3A 33 2D 26 20 1A 14
		0E 09 06 04 02 01 00 03 56 AF 24 3D 14 0E 1D 5A B8 3A 40
		39 01 00 00 00 00 02 BD 00
		39 01 00 00 00 00 03 51 0f ff
		39 01 00 00 00 00 02 53 24
		39 01 00 00 00 00 02 55 00
		39 01 00 00 78 00 02 11 00
		39 01 00 00 32 00 02 29 00
		39 01 00 00 00 00 02 35 00
		];
		qcom,mdss-dsi-off-command = [
		05 01 00 00 32 00 02 28 00
		05 01 00 00 78 00 02 10 00];
		qcom,mdss-dsi-on-command-state = "dsi_lp_mode";
		qcom,mdss-dsi-off-command-state = "dsi_hs_mode";
		qcom,mdss-dsi-lp11-init;
		qcom,mdss-dsi-h-sync-pulse = <0>;
		qcom,mdss-dsi-traffic-mode = "non_burst_sync_event";
		qcom,mdss-dsi-lane-map = "lane_map_0123";
		qcom,mdss-dsi-bllp-eof-power-mode;
		qcom,mdss-dsi-bllp-power-mode;
		qcom,mdss-dsi-tx-eot-append;
		qcom,mdss-dsi-lane-0-state;
		qcom,mdss-dsi-lane-1-state;
		qcom,mdss-dsi-lane-2-state;
		qcom,mdss-dsi-lane-3-state;
		qcom,mdss-dsi-panel-timings =
			[7a 1a 12 00 3e 42 16 1e 14 03 04 00];
		qcom,mdss-dsi-t-clk-post = <0x0a>;
		qcom,mdss-dsi-t-clk-pre = <0x1d>;

		qcom,mdss-dsi-bl-min-level = <48>;
		qcom,mdss-dsi-bl-max-level = <4095>;
		qcom,mdss-dsi-dma-trigger = "trigger_sw";
		qcom,mdss-dsi-mdp-trigger = "none";
		qcom,mdss-dsi-bl-pmic-control-type = "bl_ctrl_dcs";
		qcom,mdss-dsi-reset-sequence = <1 5>, <0 5>, <1 50>;
		qcom,mdss-pan-physical-width-dimension = <40>;
		qcom,mdss-pan-physical-height-dimension = <79>;
	};
};
