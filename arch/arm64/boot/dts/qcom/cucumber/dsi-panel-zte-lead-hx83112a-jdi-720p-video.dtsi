/* Copyright (c) 2013, The Linux Foundation. All rights reserved.
 *
 * This program is free software; you can redistribute it and/or modify
 * it under the terms of the GNU General Public License version 2 and
 * only version 2 as published by the Free Software Foundation.
 *
 * This program is distributed in the hope that it will be useful,
 * but WITHOUT ANY WARRANTY; without even the implied warranty of
 * MERCHANTABILITY or FITNESS FOR A PARTICULAR PURPOSE.  See the
 * GNU General Public License for more details.
 */

/*---------------------------------------------------------------------------
 * This file is autogenerated file using gcdb parser. Please do not edit it.
 * Update input XML file to add a new entry or update variable in this file
 * VERSION = "1.0"
 *---------------------------------------------------------------------------*/
&mdss_mdp {
	dsi_lead_hx83112a_jdi_720p_video: qcom,mdss_dsi_lead_hx83112a_jdi_720p_video {
		qcom,mdss-dsi-panel-name = "lead hx83112a jdi 720p video mode dsi panel";
		zte,lcd-init-code-version = "20200329";
		qcom,cont-splash-enabled;
		qcom,panel-supply-entries = <&dsi_panel_pwr_supply>;
		zte,lcd_bl_vsp_vsn_voltage = <0xf>;
		zte,set-reset-pin-ctrl;
		zte,lcm_reset_pin_keep_high_sleeping;
		qcom,mdss-dsi-panel-controller = <&mdss_dsi0>;
		qcom,mdss-dsi-panel-type = "dsi_video_mode";
		qcom,mdss-dsi-panel-destination = "display_1";
		qcom,mdss-dsi-panel-framerate = <60>;
		qcom,mdss-dsi-panel-clockrate = <520400000>;
		qcom,mdss-dsi-virtual-channel-id = <0>;
		qcom,mdss-dsi-stream = <0>;
		qcom,mdss-dsi-panel-width = <720>;
		qcom,mdss-dsi-panel-height = <1440>;
		qcom,mdss-dsi-h-front-porch = <40>;
		qcom,mdss-dsi-h-back-porch = <40>;
		qcom,mdss-dsi-h-pulse-width = <16>;
		qcom,mdss-dsi-h-sync-skew = <0>;
		qcom,mdss-dsi-v-back-porch = <24>;
		qcom,mdss-dsi-v-front-porch = <16>;
		qcom,mdss-dsi-v-pulse-width = <8>;
		qcom,mdss-dsi-h-left-border = <0>;
		qcom,mdss-dsi-h-right-border = <0>;
		qcom,mdss-dsi-v-top-border = <0>;
		qcom,mdss-dsi-v-bottom-border = <0>;
		qcom,mdss-dsi-bpp = <24>;
		qcom,mdss-dsi-color-order = "rgb_swap_rgb";
		qcom,mdss-dsi-underflow-color = <0xff>;
		qcom,mdss-dsi-border-color = <0>;
		qcom,mdss-dsi-on-command = [
		39 01 00 00 00 00 04 b9 83 11 2a
		39 01 00 00 00 00 02 bd 01
		39 01 00 00 00 00 11 dd 87 0f 02 04 58 20 9d 80 70 08 09 18 27 40 68 a9
		39 01 00 00 00 00 02 bd 03
		39 01 00 00 00 00 05 b2 02 d0 05 a0
		39 01 00 00 00 00 02 bd 00
		39 01 00 00 00 00 09 b1 08 27 27 83 83 4b 4e cc
		39 01 00 00 00 00 02 bd 01
		39 01 00 00 00 00 08 b1 64 01 09 20 50 00 00
		39 01 00 00 00 00 02 bd 00
		39 01 00 00 00 00 11 b2 00 02 00 80 70 00 02 1e fe 11 11 00 15 a3 87 00
		39 01 00 00 00 00 02 bd 02
		39 01 00 00 00 00 02 b2 35
		39 01 00 00 00 00 02 bd 00
		39 01 00 00 00 00 03 d2 2c 2c
		39 01 00 00 00 00 21 b4 02 60 b0 70 b0 70 4d cb 01 01 0a cb 00 ff 00 ff
		07 00 03 04 00
		39 08 08 09 00 83 00 ff 00 02 01
		39 01 00 00 00 00 02 bd 02
		39 01 00 00 00 00 0a b4 00 92 12 11 88 12 12 00 50
		39 01 00 00 00 00 02 bd 00
		39 01 00 00 00 00 03 c0 23 23
		39 01 00 00 00 00 02 cc 08
		39 01 00 00 00 00 2b d3 40 00 00 00 00 01 01 04 00 01 23 33 34 03 03 05
		05 32 10 03 00
		03 32 10 07 00 07 32 10 01 00 01 00 00 00 00 00 00 00 04 08 75
		39 01 00 00 00 00 02 bd 01
		39 01 00 00 00 00 09 d3 00 00 19 00 00 4a 00 a1
		39 01 00 00 00 00 02 bd 00
		39 01 00 00 00 00 31 d5 18 18 19 18 18 20 18 18 18 10 10 18 18 00 00 18 18 01 01 18 18
		18 18 18 18 18 18 18 2f 2f 30 30 31 31 35 35 36 36 37 37 18 18 18 18 18 18 18 18
		39 01 00 00 00 00 31 d6 18 18 19 18 18 20 19 18 18 10 10 18 18 01 01 18 18 00 00 18 18
		18 18 18 18 18 18 18 2f 2f 30 30 31 31 35 35 36 36 37 37 18 18 18 18 18 18 18 18
		39 01 00 00 00 00 19 d8 aa aa aa af ea aa aa aa aa af ea aa aa aa ab af ea aa aa aa ae af ea aa
		39 01 00 00 00 00 02 bd 01
		39 01 00 00 00 00 19 d8 aa aa aa af ea aa aa aa aa af ea aa aa aa aa af ea aa aa aa aa af ea aa
		39 01 00 00 00 00 02 bd 02
		39 01 00 00 00 00 0d d8 aa aa aa af ea aa aa aa aa af ea aa
		39 01 00 00 00 00 02 bd 03
		39 01 00 00 00 00 19 d8 ba aa aa aa bf aa aa aa aa aa bf aa aa aa aa af ea aa aa aa aa af ea aa
		39 01 00 00 00 00 02 bd 00
		39 01 00 00 00 00 14 ba 73 03 64 33 31 00 00 01 10 00 00 10 08 3d 02 77 04 00 1e
		39 01 00 00 00 00 19 e7 0e 0e 1e 6e 1e 6e 30 32 02 02 00 00 02 02 02 05 14 14 32 b9 23 b9 08 03
		39 01 00 00 00 00 02 bd 01
		39 01 00 00 00 00 0b e7 02 00 90 01 9c 0d 93 0e 03 03
		39 01 00 00 00 00 02 bd 02
		39 01 00 00 00 00 1e e7 00 00 08 00 00 00 00 00 00 00 00 00 00 00 00 00 00 00 00 00 00
		00 8c 00 00 00 00 11 20
		39 01 00 00 00 00 02 bd 01
		39 01 00 00 00 00 3a c1 ff fd fa f7 f4 f0 ed e6 e2 de db d7 d3 cf cb c6 c2 be ba b1 a8
		9f 96 8d 84 7c 73 6a 61 58 4f 47 40 38 2f 27 1f 18 11 0a 06 05 02 01 00 3f b9 b0 73 fa
		aa c4 6b 4a e4 9e 00
		39 01 00 00 00 00 02 bd 02
		39 01 00 00 00 00 02 b2 35
		39 01 00 00 00 00 3a c1 ff fd fa f7 f4 f0 ed e6 e2 de db d7 d3 cf cb c6 c2 be ba b1 a8
		9f 96 8d 84 7c 73 6a 61 58 4f 47 40 38 2f 27 1f 18 11 0a 06 05 02 01 00 3f b9 b0 73 fa
		aa c4 6b 4a e4 9e 00
		39 01 00 00 00 00 02 bd 03
		39 01 00 00 00 00 3a c1 ff fd fa f7 f4 f0 ed e6 e2 de db d7 d3 cf cb c6 c2 be ba b1 a8
		9f 96 8d 84 7c 73 6a 61 58 4f 47 40 38 2f 27 1f 18 11 0a 06 05 02 01 00 3f b9 b0 73 fa
		aa c4 6b 4a e4 9e 00
		39 01 00 00 00 00 02 bd 00
		39 01 00 00 00 00 02 c1 01
		39 01 00 00 00 00 02 bd 01
		39 01 00 00 00 00 03 cb 25 11
		39 01 00 00 00 00 02 bd 00
		39 01 00 00 00 00 07 cb 11 10 91 fc 00 02
		39 01 00 00 00 00 08 c7 70 00 04 e0 33 00 22
		39 01 00 00 00 00 02 cd 01
		39 01 00 00 00 00 05 bf 0f 00 00 83
		39 01 00 00 00 00 04 be 01 96 88
		39 01 00 00 00 00 04 d9 00 01 3f
		39 01 00 00 00 00 02 e4 2d
		39 01 00 00 00 00 03 51 0f ff
		39 01 00 00 00 00 02 53 24
		39 01 00 00 00 00 02 55 00
		39 01 00 00 00 00 05 c9 04 09 1D 00
		39 01 00 00 78 00 02 11 00
		39 01 00 00 32 00 02 29 00];
		qcom,mdss-dsi-off-command = [
		39 01 00 00 00 00 02 53 00
		05 01 00 00 32 00 02 28 00
		05 01 00 00 78 00 02 10 00];
		qcom,mdss-dsi-on-command-state = "dsi_lp_mode";
		qcom,mdss-dsi-off-command-state = "dsi_lp_mode";
		qcom,mdss-dsi-lp11-init;
		qcom,mdss-dsi-h-sync-pulse = <1>;
		qcom,mdss-dsi-traffic-mode = "burst_mode";
		qcom,mdss-dsi-lane-map = "lane_map_0123";
		qcom,mdss-dsi-bllp-eof-power-mode;
		qcom,mdss-dsi-bllp-power-mode;
		qcom,mdss-dsi-lane-0-state;
		qcom,mdss-dsi-lane-1-state;
		qcom,mdss-dsi-lane-2-state;
		qcom,mdss-dsi-lane-3-state;
		qcom,mdss-dsi-panel-timings = [94 20 14 00 46 4A 1A 24 18 03 04 00];
		qcom,mdss-dsi-t-clk-post = <0x04>;
		qcom,mdss-dsi-t-clk-pre = <0x1D>;
		qcom,mdss-dsi-bl-min-level = <48>;
		qcom,mdss-dsi-bl-max-level = <4095>;
		qcom,mdss-dsi-dma-trigger = "trigger_sw";
		qcom,mdss-dsi-mdp-trigger = "none";
		qcom,mdss-dsi-bl-pmic-control-type = "bl_ctrl_dcs";
		qcom,mdss-dsi-reset-sequence = <1 5>, <0 5>, <1 50>;
		qcom,mdss-pan-physical-width-dimension = <64>;
		qcom,mdss-pan-physical-height-dimension = <128>;
		qcom,mdss-dsi-tx-eot-append;
		qcom,mdss-dsi-post-init-delay = <1>;
		qcom,esd-check-enabled;
		qcom,mdss-dsi-panel-status-check-mode = "reg_read";
		qcom,mdss-dsi-panel-status-command = [06 01 00 01 00 00 01 0a];
		qcom,mdss-dsi-panel-status-command-state = "dsi_hs_mode";
		qcom,mdss-dsi-panel-status-value = <0x9c 0x9c 0x9c 0x9c>;
		qcom,mdss-dsi-panel-on-check-value = <0x9c 0x9c 0x9c 0x9c>;
		qcom,mdss-dsi-panel-status-read-length = <4>;
		qcom,mdss-dsi-panel-max-error-count = <3>;

	};
};
