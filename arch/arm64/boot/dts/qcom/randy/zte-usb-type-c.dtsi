/*
 * Copyright (c) 2015 The Linux Foundation. All rights reserved.
 *
 * This program is free software; you can redistribute it and/or modify
 * it under the terms of the GNU General Public License version 2 and
 * only version 2 as published by the Free Software Foundation.
 *
 * This program is distributed in the hope that it will be useful,
 * but WITHOUT ANY WARRANTY; without even the implied warranty of
 * MERCHANTABILITY or FITNESS FOR A PARTICULAR PURPOSE.  See the
 * GNU General Public License for more details.
 */

/* For Reference
 * GPIO_ACTIVE_HIGH = (0 << 0)
 * GPIO_ACTIVE_LOW  = (1 << 0)
 * GPIO_OPEN_DRAIN  = (1 << 1)
 * GPIO_OPEN_SOURCE = (1 << 2)
 */


/* Segment 1: Type-C Chips main DTS config */
&i2c_2 {
	/* TI HD3SS3220 chip */
	hd3ss3220@47 { /* slave id 0x67(ADDR Pin:H) or 0x47(ADDR Pin:L) */
		compatible = "ti,hd3ss3220";
		reg = <0x47>;

		/* PM GPIO ( 14 ) Irq Line */
		hd3ss,irq_gpio = <&tlmm 36 0x2>;

		/* PM MPP ( 05 ) EN_CC/MUX */
		hd3ss,en_cc_gpio = <&tlmm 140 0x0>;
		/* PM MPP ( 07 ) Re-drive */
		/*hd3ss,re_drv_gpio = <&pm8953_mpps 7 0x0>;*/

		/* PMI GPIO ( 08 ) vreg 5V */
		/*hd3ss,vreg_5v_gpio = <&pm8953_gpios 8 0x0>;*/
		/* PMI GPIO ( 09 ) vreg 3V3 */
		/*hd3ss,vreg_3v3_gpio = <&pm8953_gpios 9 0x0>;*/
	};

pi5usb302@1D {
		compatible = "ti,PI5USB30216D";
		reg = <0x1D>;
		status = "okay";
		pinctrl-names = "PI5USB30216D_intpin", "PI5USB30216D_enpin_output0", "PI5USB30216D_enpin_output1";
		pinctrl-0 = <&typec_intpin_cfg>;
		pinctrl-1 = <&typec_enpin_output0>;
		pinctrl-2 = <&typec_enpin_output1>;
	eint_PI5USB30216D@36 {
			compatible = "ti,PI5USB30216D_eint";
			pi5usb,irq_gpio = <&tlmm 36 0x2>;
		};
	};
};
